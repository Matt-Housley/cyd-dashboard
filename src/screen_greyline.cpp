#include "screen_greyline.h"
#include "ui_common.h"
#include "config.h"
#include "data_store.h"
#include "settings.h"
#include <time.h>
#include <math.h>
#include "fonts/ui_fonts.h"

// ─── Map parameters ───────────────────────────────────────────────────────────
// Default: MAP_TOP=75°N  MAP_BTM=-63°S  → MAP_RNG=138°
static const int   MAP_Y0  = STATUS_H;
static const int   MAP_W   = SCREEN_W;
static const int   MAP_H   = CONTENT_H;

// Mutable projection state — set before each drawWorldMapImpl() call
static float g_mapLonMin = -180.0f;
static float g_mapLonRng = 360.0f;
static float g_mapLatTop = 75.0f;
static float g_mapLatRng = 138.0f;

static inline int lonToX(float lon) {
    return (int)((lon - g_mapLonMin) / g_mapLonRng * MAP_W);
}
static inline int latToY(float lat) {
    return MAP_Y0 + (int)((g_mapLatTop - lat) / g_mapLatRng * MAP_H);
}

// ─── World outline — (lon×2, lat×2) pairs stored in PROGMEM ──────────────────
// Generated from Natural Earth 50m.  Half-degree resolution: renderer divides
// each value by 2.0f to get degrees.  -999/-999 separates polygons;
// -9999/-9999 is the end sentinel.
// 31 polygons, ~5590 values ≈ 11 KB flash.
static const int16_t WORLD_MAP[] PROGMEM = {
    36,119, 32,117, 32,112, 26,111, 21,120, 16,116,
    11,117, 13,119, 10,119, 14,121, 10,119, 10,122,
    15,122, 10,124, 23,128, 19,127, 37,139, 50,142,
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    -9999,-9999


};

// ─── Scanline polygon fill + outline ─────────────────────────────────────────
static void fillPolygon(const int* px, const int* py, int n,
                        uint32_t fillCol, uint32_t edgeCol) {
    if (n < 3) return;
    int minY = py[0], maxY = py[0];
    for (int i = 1; i < n; i++) {
        if (py[i] < minY) minY = py[i];
        if (py[i] > maxY) maxY = py[i];
    }
    minY = max(minY, MAP_Y0);
    maxY = min(maxY, MAP_Y0 + MAP_H - 1);

    for (int y = minY; y <= maxY; y++) {
        int xs[96]; int nxs = 0;
        for (int i = 0; i < n && nxs < 94; i++) {
            int j = (i + 1) % n;
            int y0 = py[i], y1 = py[j];
            if (y0 == y1) continue;
            if ((y0 <= y && y < y1) || (y1 <= y && y < y0))
                xs[nxs++] = px[i] + (y - y0) * (px[j] - px[i]) / (y1 - y0);
        }
        for (int a = 1; a < nxs; a++) {
            int k = xs[a], b = a - 1;
            while (b >= 0 && xs[b] > k) { xs[b+1] = xs[b]; b--; }
            xs[b+1] = k;
        }
        for (int a = 0; a + 1 < nxs; a += 2)
            spr.drawFastHLine(xs[a], y, xs[a+1] - xs[a] + 1, fillCol);
    }
    for (int i = 0; i < n; i++) {
        int j = (i + 1) % n;
        int y0 = constrain(py[i], MAP_Y0, MAP_Y0 + MAP_H - 1);
        int y1 = constrain(py[j], MAP_Y0, MAP_Y0 + MAP_H - 1);
        spr.drawLine(px[i], y0, px[j], y1, edgeCol);
    }
}

static void drawWorldMapImpl();

void drawWorldMap() {
    g_mapLonMin = -180.0f;
    g_mapLonRng = 360.0f;
    g_mapLatTop = 75.0f;
    g_mapLatRng = 138.0f;
    drawWorldMapImpl();
}

void drawWorldMapZoomed(float lonMin, float lonMax, float latMin, float latMax) {
    g_mapLonMin = lonMin;
    g_mapLonRng = lonMax - lonMin;
    g_mapLatTop = latMax;
    g_mapLatRng = latMax - latMin;
    drawWorldMapImpl();
}

static void drawWorldMapImpl() {
    // ── Compute sun position (needed for day/night fill and terminator) ────────
    time_t rawNow = time(nullptr);
    struct tm utcTm;
    gmtime_r(&rawNow, &utcTm);

    float utcHour = utcTm.tm_hour + utcTm.tm_min / 60.0f + utcTm.tm_sec / 3600.0f;
    float sunLon  = (utcHour - 12.0f) * -15.0f;

    int   doy  = utcTm.tm_yday + 1;
    float B    = (2.0f * (float)M_PI / 365.0f) * (doy - 1);
    float decl = 0.006918f
               - 0.399912f * cosf(B) + 0.070257f * sinf(B)
               - 0.006758f * cosf(2*B) + 0.000907f * sinf(2*B)
               - 0.002697f * cosf(3*B) + 0.001480f * sinf(3*B);
    float declDeg = decl * 180.0f / (float)M_PI;

    // ── Day / night ocean fill ─────────────────────────────────────────────────
    uint32_t dayOcean   = C(COL_OCEAN);
    uint32_t nightOcean = spr.color888(3, 8, 18);

    for (int x = 0; x < MAP_W; x++) {
        float lon = g_mapLonMin + (float)x / MAP_W * g_mapLonRng;
        float ld  = lon - sunLon;
        while (ld >  180.0f) ld -= 360.0f;
        while (ld < -180.0f) ld += 360.0f;
        bool night = (ld < -90.0f || ld > 90.0f);
        spr.drawFastVLine(x, MAP_Y0, MAP_H, night ? nightOcean : dayOcean);
    }

    // ── Grid lines ────────────────────────────────────────────────────────────
    uint32_t gridCol = spr.color888(18, 36, 55);
    for (int lat = -75; lat <= 75; lat += 15) {
        int gy = latToY((float)lat);
        if (gy >= MAP_Y0 && gy < MAP_Y0 + MAP_H)
            spr.drawFastHLine(0, gy, MAP_W, gridCol);
    }
    for (int lon = -180; lon <= 180; lon += 60) {
        int gx = lonToX((float)lon);
        if (gx >= 0 && gx < MAP_W)
            spr.drawFastVLine(gx, MAP_Y0, MAP_H, gridCol);
    }
    {
        int eqY = latToY(0.0f);
        if (eqY >= MAP_Y0 && eqY < MAP_Y0 + MAP_H)
            spr.drawFastHLine(0, eqY, MAP_W, spr.color888(24, 52, 76));
    }

    // ── Continents ────────────────────────────────────────────────────────────
    uint32_t landFill = C(COL_LAND);
    uint32_t landEdge = C(COL_LAND_EDGE);

    static int polyPx[370], polyPy[370];
    int polyN = 0, idx = 0;

    while (true) {
        int16_t mlon = (int16_t)pgm_read_word(&WORLD_MAP[idx]);
        int16_t mlat = (int16_t)pgm_read_word(&WORLD_MAP[idx + 1]);
        idx += 2;
        if (mlon == -9999) {
            if (polyN >= 3) fillPolygon(polyPx, polyPy, polyN, landFill, landEdge);
            break;
        }
        if (mlon == -999) {
            if (polyN >= 3) fillPolygon(polyPx, polyPy, polyN, landFill, landEdge);
            polyN = 0;
            continue;
        }
        if (polyN < 370) {
            polyPx[polyN] = lonToX((float)mlon / 2.0f);
            polyPy[polyN] = latToY((float)mlat / 2.0f);
            polyN++;
        }
    }

    // ── Night-side land stipple ───────────────────────────────────────────────
    {
        uint32_t stipple = spr.color888(0, 4, 10);
        for (int x = 0; x < MAP_W; x++) {
            float lon = g_mapLonMin + (float)x / MAP_W * g_mapLonRng;
            float ld  = lon - sunLon;
            while (ld >  180.0f) ld -= 360.0f;
            while (ld < -180.0f) ld += 360.0f;
            if (ld < -90.0f || ld > 90.0f) {
                int yStart = MAP_Y0 + (x & 1);
                for (int y = yStart; y < MAP_Y0 + MAP_H; y += 2)
                    spr.drawPixel(x, y, stipple);
            }
        }
    }

    // ── Terminator line ───────────────────────────────────────────────────────
    uint32_t termCol = C(COL_ORANGE);
    int prevTx = -1, prevTy = -1;
    for (int lon = -180; lon <= 180; lon += 2) {
        float lonDelta = (lon - sunLon) * (float)M_PI / 180.0f;
        float tanDecl  = tanf(decl);
        if (fabsf(tanDecl) < 1e-6f) continue;
        float latRad = atanf(-cosf(lonDelta) / tanDecl);
        float latDeg = latRad * 180.0f / (float)M_PI;
        if (!isfinite(latDeg)) continue;
        int tx = lonToX((float)lon);
        int ty = constrain(latToY(latDeg), MAP_Y0, MAP_Y0 + MAP_H - 1);
        if (prevTx >= 0 && (lon / 2) % 2 == 0)
            spr.drawLine(prevTx, prevTy, tx, ty, termCol);
        prevTx = tx; prevTy = ty;
    }

    // ── Sun dot ───────────────────────────────────────────────────────────────
    int sunX = lonToX(sunLon);
    int sunY = constrain(latToY(declDeg), MAP_Y0 + 4, MAP_Y0 + MAP_H - 4);
    spr.fillCircle(sunX, sunY, 6, spr.color888(255, 224, 64));
    spr.drawCircle(sunX, sunY, 8, spr.color888(255, 180, 0));

    // ── QTH marker ────────────────────────────────────────────────────────────
    int qthX = lonToX(g_settings.lon);
    int qthY = latToY(g_settings.lat);
    spr.fillCircle(qthX, qthY, 3, C(COL_ORANGE));
    spr.drawCircle(qthX, qthY, 5, C(COL_ORANGE));
    int lx = (qthX < SCREEN_W - 50) ? qthX + 7 : qthX - 44;
    spr.setFont(UI_FONT_9);
    spr.setTextColor(C(COL_ORANGE));
    spr.setCursor(lx, qthY - 10);
    spr.print(g_settings.grid);
}

void drawScreenGreyLine() {
    drawWorldMap();

    // ── ISS orbit track + marker ─────────────────────────────────────────────
    {
        xSemaphoreTake(g_dataMutex, portMAX_DELAY);
        ISSData iss = g_iss;
        xSemaphoreGive(g_dataMutex);

        // ── Upcoming orbit track (draw first so marker sits on top) ──────────
        if (iss.valid && iss.trackCount >= 2) {
            // Alternate solid / gap every other segment for a dashed appearance
            uint32_t trackCol = spr.color888(0, 100, 130);   // dim teal
            float prevLon = iss.trackLon[0];
            int   prevX   = lonToX(iss.trackLon[0]);
            int   prevY   = latToY(iss.trackLat[0]);
            for (int k = 1; k < iss.trackCount; k++) {
                float curLon = iss.trackLon[k];
                int   curX   = lonToX(curLon);
                int   curY   = latToY(iss.trackLat[k]);

                // Skip segment that would wrap across the anti-meridian
                bool crossesAntimeridian = (fabsf(curLon - prevLon) > 150.0f);
                // Draw only odd-numbered segments for dashed appearance
                bool draw = (k % 2 == 1) && !crossesAntimeridian;
                if (draw)
                    spr.drawLine(prevX, prevY, curX, curY, trackCol);

                prevX   = curX;
                prevY   = curY;
                prevLon = curLon;
            }
        }

        if (iss.valid) {
            uint32_t issCol  = spr.color888(0, 220, 255);   // cyan-white
            uint32_t issGlow = spr.color888(0, 80, 100);    // dim halo

            int ix = lonToX(iss.lon);
            int iy = latToY(iss.lat);

            // Clamp to map area
            ix = constrain(ix, 4, MAP_W - 5);
            iy = constrain(iy, MAP_Y0 + 4, MAP_Y0 + MAP_H - 5);

            // Body: small filled circle + dim halo
            spr.fillCircle(ix, iy, 3, issGlow);
            spr.fillCircle(ix, iy, 2, issCol);

            // Solar panel "wings" — two short horizontal bars
            spr.drawFastHLine(ix - 6, iy - 1, 4, issCol);
            spr.drawFastHLine(ix - 6, iy,     4, issCol);
            spr.drawFastHLine(ix + 3, iy - 1, 4, issCol);
            spr.drawFastHLine(ix + 3, iy,     4, issCol);

            // Label — place above/below depending on map position
            spr.setFont(UI_FONT_9);
            spr.setTextColor(issCol);
            int labelY = (iy - MAP_Y0 > 16) ? iy - 12 : iy + 6;
            int labelX = (ix < SCREEN_W - 22) ? ix - 4 : ix - 20;
            spr.setCursor(labelX, labelY);
            spr.print("ISS");
        }
    }

    // ── UTC time overlay ──────────────────────────────────────────────────────
    struct tm utcTm;
    { time_t t = time(nullptr); gmtime_r(&t, &utcTm); }
    char tbuf[6];
    strftime(tbuf, sizeof(tbuf), "%H:%M", &utcTm);
    spr.setTextColor(spr.color888(160, 160, 160));
    int tw = spr.textWidth(tbuf);
    spr.setCursor(SCREEN_W - tw - 3, MAP_Y0 + 2);
    spr.print(tbuf);
}
